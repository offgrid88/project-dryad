## esp32_lcd_project/sdkconfig.defaults
```kconfig
# ESP32-C3 Circular LCD Project Configuration

# Target chip
CONFIG_IDF_TARGET="esp32c3"

# Serial flasher config
CONFIG_ESPTOOLPY_FLASHMODE_DIO=y
CONFIG_ESPTOOLPY_FLASHFREQ_80M=y
CONFIG_ESPTOOLPY_FLASHSIZE_4MB=y

# Partition Table
CONFIG_PARTITION_TABLE_SINGLE_APP=y
CONFIG_PARTITION_TABLE_CUSTOM_FILENAME="partitions.csv"
CONFIG_PARTITION_TABLE_FILENAME="partitions_singleapp.csv"

# ESP32C3-specific
CONFIG_ESP32C3_DEFAULT_CPU_FREQ_160=y
CONFIG_ESP32C3_DEFAULT_CPU_FREQ_MHZ=160

# FreeRTOS
CONFIG_FREERTOS_HZ=1000
CONFIG_FREERTOS_TIMER_TASK_STACK_DEPTH=3072

# Log output
CONFIG_LOG_DEFAULT_LEVEL_INFO=y
CONFIG_LOG_COLORS=y
CONFIG_LOG_TIMESTAMP_SOURCE_RTOS=y

# LCD Configuration
CONFIG_LCD_PANEL_IO_FORMAT_BUF_SIZE=4096

# SPI Configuration
CONFIG_SPI_MASTER_ISR_IN_IRAM=y
CONFIG_SPI_MASTER_IN_IRAM=y

# ESP Timer
CONFIG_ESP_TIMER_PROFILING=n

# Heap
CONFIG_HEAP_POISONING_LIGHT=y

# Stack Smashing Protection
CONFIG_COMPILER_STACK_CHECK_MODE_NORM=y

# Watchdog
CONFIG_ESP_TASK_WDT_PANIC=n
CONFIG_ESP_TASK_WDT_TIMEOUT_S=10

# GPIO
CONFIG_GPIO_CTRL_FUNC_IN_IRAM=y

# Sleep
CONFIG_ESP_SLEEP_POWER_DOWN_FLASH=n

# Optimization
CONFIG_COMPILER_OPTIMIZATION_SIZE=y
CONFIG_COMPILER_OPTIMIZATION_ASSERTIONS_ENABLE=y
```

## sdkconfig.defaults
```kconfig
# Common configuration for all targets

# Partition Table
CONFIG_PARTITION_TABLE_CUSTOM=y
CONFIG_PARTITION_TABLE_CUSTOM_FILENAME="partitions.csv"

# Enable FreeRTOS stats for debugging
CONFIG_FREERTOS_GENERATE_RUN_TIME_STATS=y
CONFIG_FREERTOS_USE_STATS_FORMATTING_FUNCTIONS=y
CONFIG_FREERTOS_USE_TRACE_FACILITY=y

# Log output
CONFIG_LOG_DEFAULT_LEVEL_INFO=y
CONFIG_LOG_MAXIMUM_LEVEL_VERBOSE=y
CONFIG_LOG_COLORS=y

# Main task stack size
CONFIG_ESP_MAIN_TASK_STACK_SIZE=4096

# Enable panic handler
CONFIG_ESP_SYSTEM_PANIC_PRINT_REBOOT=y

# ADC Configuration
CONFIG_ADC_ONESHOT_CTRL_FUNC_IN_IRAM=n

# Disable unnecessary features to save space
CONFIG_ESP_WIFI_SOFTAP_SUPPORT=n

# LVGL fonts (used across all display-equipped boards)
CONFIG_LV_FONT_MONTSERRAT_14=y
CONFIG_LV_FONT_MONTSERRAT_16=y
```

## sdkconfig.defaults.esp32c3
```kconfig
# ESP32-C3 flash configuration
CONFIG_ESPTOOLPY_FLASHMODE_DIO=y
CONFIG_ESPTOOLPY_FLASHFREQ_80M=y
CONFIG_ESPTOOLPY_FLASHSIZE_4MB=y
```

## sdkconfig.defaults.esp32c6
```kconfig
# ESP32-C6 flash configuration
CONFIG_ESPTOOLPY_FLASHMODE_DIO=y
CONFIG_ESPTOOLPY_FLASHFREQ_80M=y
CONFIG_ESPTOOLPY_FLASHSIZE_4MB=y
```

## sdkconfig.defaults.esp32s3
```kconfig
# ESP32-S3 flash configuration
CONFIG_ESPTOOLPY_FLASHMODE_DIO=y
CONFIG_ESPTOOLPY_FLASHFREQ_80M=y
CONFIG_ESPTOOLPY_FLASHSIZE_8MB=y
```
